## sdkconfig.defaults
```kconfig
# 禁用蓝牙以节省大量内存（约100KB+）
# CONFIG_BT_ENABLED is not set
CONFIG_BT_ENABLED=n

# TLS/SSL配置 - 跳过证书验证（仅用于开发环境）
CONFIG_MBEDTLS_CERTIFICATE_BUNDLE=n
# ESP-IDF v5.x 需要显式设置跳过服务器证书验证
CONFIG_ESP_TLS_INSECURE=y
CONFIG_ESP_TLS_SKIP_SERVER_CERT_VERIFY=y



# CONFIG_ESP32S3_DATA_CACHE_LINE_64B is not set
# CONFIG_ESP32S3_DATA_CACHE_LINE_SIZE=64

CONFIG_FATFS_LFN_STACK=y
CONFIG_FATFS_MAX_LFN=255
CONFIG_FATFS_API_ENCODING_ANSI_OEM=y

CONFIG_ESPTOOLPY_FLASHSIZE_16MB=y
CONFIG_PARTITION_TABLE_CUSTOM=y

# 增加HTTP头部缓冲区大小（支持长token）
CONFIG_ESP_HTTP_CLIENT_MAX_HTTP_HEADER_LEN=4096

# ==================== mbedTLS 内存优化（关键！与 koi_esp32 一致）====================
# 使用动态缓冲区而非静态缓冲区 - 这是解决内存不足的关键配置！
CONFIG_MBEDTLS_DYNAMIC_BUFFER=y
# 不保留对等证书，节省内存
CONFIG_MBEDTLS_SSL_KEEP_PEER_CERTIFICATE=n
# 关键：不要强制使用内部 RAM 分配 mbedTLS（让它使用 PSRAM）
# CONFIG_MBEDTLS_INTERNAL_MEM_ALLOC is not set

# ==================== WiFi 内存优化 ====================
# 禁用 WiFi IRAM 优化，节省内部 RAM
CONFIG_ESP_WIFI_IRAM_OPT=n
CONFIG_ESP_WIFI_RX_IRAM_OPT=n
# 使用动态 RX 管理缓冲区
CONFIG_ESP_WIFI_DYNAMIC_RX_MGMT_BUFFER=y

CONFIG_ESP_DEFAULT_CPU_FREQ_MHZ_240=y


#CONFIG_FREERTOS_HZ=1000

#CONFIG_ESPTOOLPY_FLASHMODE_QIO=y
#CONFIG_ESPTOOLPY_FLASHFREQ_120M=y

# ==================== PSRAM Configuration ====================
# 8MB Octal PSRAM 配置
CONFIG_SPIRAM_MODE_OCT=y
# CONFIG_SPIRAM_MODE_QUAD is not set

# PSRAM 速度配置（80MHz 是安全的默认值）
CONFIG_SPIRAM_SPEED_80M=y

#CONFIG_IDF_EXPERIMENTAL_FEATURES=y
#CONFIG_SPIRAM_SPEED_120M=y

# 将代码和只读数据放入 PSRAM（可选，可以释放更多 Flash 缓存）
#CONFIG_SPIRAM_FETCH_INSTRUCTIONS=y
#CONFIG_SPIRAM_RODATA=y
#CONFIG_ESP32S3_DATA_CACHE_LINE_64B=y
#CONFIG_COMPILER_OPTIMIZATION_PERF=y
########################################################################################
#############################################################################################
CONFIG_ESP_CONSOLE_USB_SERIAL_JTAG=y
CONFIG_FLASHMODE_QIO=y

# ==================== PSRAM 核心配置（与 koi_esp32 一致）====================
CONFIG_SPIRAM=y
CONFIG_SPIRAM_BOOT_INIT=y
# CONFIG_SPIRAM_IGNORE_NOTFOUND is not set
# 关键：使用 MALLOC 模式，让 malloc 自动使用 PSRAM
CONFIG_SPIRAM_USE_MALLOC=y
# 禁用内存测试以加快启动
# CONFIG_SPIRAM_MEMTEST is not set
CONFIG_SPIRAM_MALLOC_ALWAYSINTERNAL=4096
# 增加内部 RAM 保留空间（与 koi_esp32 一致：49152）
CONFIG_SPIRAM_MALLOC_RESERVE_INTERNAL=49152
CONFIG_SPIRAM_TRY_ALLOCATE_WIFI_LWIP=y
# 注意：USE_CAPS_ALLOC 和 USE_MALLOC 互斥，这里不设置 CAPS_ALLOC

# Data Cache 配置
# 注意：保留默认配置，不强制设置 64KB cache


# 内存优化配置（与 koi_esp32 一致）
# 注意：koi_esp32 没有启用 BSS 段外部内存
# CONFIG_SPIRAM_ALLOW_BSS_SEG_EXTERNAL_MEMORY is not set

#
# Use WIFI when PSRAM is enabled
#
# 优化WiFi缓冲区配置 - 减少内部RAM占用
CONFIG_ESP_WIFI_STATIC_RX_BUFFER_NUM=5
CONFIG_ESP_WIFI_DYNAMIC_RX_BUFFER_NUM=16
CONFIG_ESP_WIFI_RX_BA_WIN=6
CONFIG_LWIP_TCP_OOSEQ_MAX_PBUFS=4
CONFIG_ESP32_WIFI_RX_BA_WIN=6
CONFIG_ESP32_WIFI_RX_BA_WIN=6

# 优化主任务栈大小
CONFIG_ESP_MAIN_TASK_STACK_SIZE=4096

CONFIG_OPENTHREAD_RX_ON_WHEN_IDLE=y
#
# I2S Configuration
#
CONFIG_I2S_ISR_IRAM_SAFE=y
CONFIG_I2S_SUPPRESS_DEPRECATE_WARN=y
CONFIG_I2S_ENABLE_DEBUG_LOG=y

# FreeRTOS Trace Facility for uxTaskGetSystemState
CONFIG_FREERTOS_USE_TRACE_FACILITY=y

# LVGL 9.2.2

CONFIG_LV_OS_NONE=y
CONFIG_LV_USE_OS=0
CONFIG_LV_USE_CLIB_MALLOC=y
CONFIG_LV_USE_CLIB_STRING=y
CONFIG_LV_USE_CLIB_SPRINTF=y
CONFIG_LV_USE_IMGFONT=y
CONFIG_LV_USE_USER_DATA=y
CONFIG_LV_USE_PERF_MONITOR=y
CONFIG_LV_COLOR_16_SWAP=y

CONFIG_LV_FONT_MONTSERRAT_12=y
CONFIG_LV_FONT_MONTSERRAT_14=y
CONFIG_LV_FONT_MONTSERRAT_16=y

# Use compressed font
CONFIG_LV_FONT_FMT_TXT_LARGE=y
CONFIG_LV_USE_FONT_COMPRESSED=y
CONFIG_LV_USE_FONT_PLACEHOLDER=y

# Disable extra widgets to save flash size
CONFIG_LV_USE_ANIMIMG=n
CONFIG_LV_USE_CALENDAR=n
CONFIG_LV_USE_CALENDAR_HEADER_ARROW=n
CONFIG_LV_USE_CALENDAR_HEADER_DROPDOWN=n
CONFIG_LV_USE_CHART=n
CONFIG_LV_USE_KEYBOARD=n
CONFIG_LV_USE_LED=n
CONFIG_LV_USE_LIST=n
CONFIG_LV_USE_MENU=n
CONFIG_LV_USE_MSGBOX=n
CONFIG_LV_USE_SPAN=n
CONFIG_LV_USE_SPINBOX=n
CONFIG_LV_USE_SPINNER=y
CONFIG_LV_USE_TABVIEW=n
CONFIG_LV_USE_TILEVIEW=n
CONFIG_LV_USE_WIN=n

CONFIG_LV_BUILD_EXAMPLES=n
```
